## firmware/main/Kconfig.projbuild
```kconfig
menu "Alpha Stick"

    choice AS_BUILD_PROFILE
        prompt "Build profile"
        default AS_BUILD_PROFILE_GAMING
        help
            DRIVE is the ATOS input build: mandatory dual-sensor cross-check,
            no auto-tare, radios off in wired mode. See docs/DESIGN_V2.md sec 9.

        config AS_BUILD_PROFILE_GAMING
            bool "Gaming"
        config AS_BUILD_PROFILE_DRIVE
            bool "Drive (ATOS input)"
    endchoice

    choice AS_ROLE
        prompt "Device role"
        default AS_ROLE_STICK

        config AS_ROLE_STICK
            bool "Stick"
        config AS_ROLE_DONGLE
            bool "Dongle (AS-Link to USB bridge)"
    endchoice

    config AS_SIMULATE_WHEN_NO_SENSOR
        bool "Simulate stick input when no sensor is found"
        default y
        help
            With no TMAG5273 on the bus, synthesize a slow circle plus a
            periodic Z-press so HID transports can be tested on a bare devkit.

endmenu
```

## firmware/sdkconfig.defaults
```kconfig
# Alpha Stick V2 defaults. Unknown symbols are silently ignored by idf.py,
# so esp_tinyusb options here are safe across component versions.

CONFIG_IDF_TARGET="esp32s3"

# 1 ms FreeRTOS tick so vTaskDelayUntil(1) is the 1 kHz loop period
CONFIG_FREERTOS_HZ=1000

# DevKitC-1 N8R2 class flash
CONFIG_ESPTOOLPY_FLASHSIZE_8MB=y
CONFIG_PARTITION_TABLE_CUSTOM=y
CONFIG_PARTITION_TABLE_CUSTOM_FILENAME="partitions.csv"

# esp_tinyusb: one HID interface (composite report IDs), CDC for config
CONFIG_TINYUSB_HID_COUNT=1
CONFIG_TINYUSB_CDC_ENABLED=y
CONFIG_TINYUSB_CDC_COUNT=1
```
